#include "cyrillic_mapper.h"

const uint8_t CyrillicMapper::CYRILLIC_BASE;
const uint8_t CyrillicMapper::GLYPH_COUNT;

// Битовые схемы глифов 5x8, один байт на строку, бит 0 = левый столбец.
// Порядок: А-Я, Ё, затем а-я, затем ё.
static const uint8_t glyphTable[66][8] PROGMEM = {
  { 0x04, 0x11, 0x11, 0x11, 0x1F, 0x11, 0x11, 0x00 }, // А
  { 0x0F, 0x09, 0x09, 0x09, 0x0F, 0x11, 0x11, 0x07 }, // Б
  { 0x11, 0x11, 0x11, 0x0A, 0x04, 0x00, 0x00, 0x00 }, // В
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  { 0x0A, 0x0E, 0x11, 0x0F, 0x01, 0x11, 0x0E, 0x00 }, // ё
};

bool CyrillicMapper::isCyrillic(uint16_t codePoint) {
  return codePoint >= 0x0400 && codePoint <= 0x052F;
}

uint8_t CyrillicMapper::glyphIndex(uint16_t codePoint) {
  if (codePoint >= 0x0410 && codePoint <= 0x042F) {
    return uint8_t(codePoint - 0x0410); // А-Я -> 0..31
  }
  if (codePoint == 0x0401) {
    return 32; // Ё
  }
  if (codePoint >= 0x0430 && codePoint <= 0x044F) {
    return uint8_t(codePoint - 0x0430 + 33); // а-я -> 33..64
  }
  if (codePoint == 0x0451) {
    return 65; // ё
  }
  return 0xFF;
}

void CyrillicMapper::readGlyph(uint8_t index, uint8_t* out) {
  if (index >= GLYPH_COUNT) {
    memset(out, 0, 8);
    return;
  }
  for (uint8_t row = 0; row < 8; row++) {
    out[row] = pgm_read_byte(&glyphTable[index][row]);
  }
}

uint8_t CyrillicMapper::mapToCyril(const String& text, uint8_t* out, uint8_t outSize) const {
  return mapToCyril(text.c_str(), out, outSize);
}

uint8_t CyrillicMapper::mapToCyril(const char* text, uint8_t* out, uint8_t outSize) const {
  if (text == nullptr) {
    return 0;
  }
  return mapToCyril((const uint8_t*)text, strlen(text), out, outSize);
}

uint8_t CyrillicMapper::mapToCyril(const uint8_t* data, uint8_t length, uint8_t* out, uint8_t outSize) const {
  if (out == nullptr || outSize == 0) {
    return 0;
  }

  uint8_t o = 0;
  uint8_t i = 0;
  while (i < length && o + 1 < outSize) {
    uint8_t b = data[i];

    // ASCII (0x00-0x7F) проходит без изменений
    if (b < 0x80) {
      out[o++] = b;
      i++;
      continue;
    }

    // Декодирование UTF-8 (2 и 3 байта)
    uint16_t cp = 0;
    uint8_t seq = 0;
    if ((b >= 0xC2 && b <= 0xDF) && i + 1 < length && (data[i + 1] & 0xC0) == 0x80) {
      cp = ((b & 0x1F) << 6) | (data[i + 1] & 0x3F);
      seq = 2;
    } else if ((b >= 0xE0 && b <= 0xEF) && i + 2 < length &&
               (data[i + 1] & 0xC0) == 0x80 && (data[i + 2] & 0xC0) == 0x80) {
      cp = ((b & 0x0F) << 12) | ((data[i + 1] & 0x3F) << 6) | (data[i + 2] & 0x3F);
      seq = 3;
    }

    if (seq > 0) {
      if (isCyrillic(cp)) {
        uint8_t index = glyphIndex(cp);
        if (index != 0xFF) {
          out[o++] = CYRILLIC_BASE + index;
        }
      } else {
        for (uint8_t k = 0; k < seq && o + 1 < outSize; k++) {
          out[o++] = data[i + k];
        }
      }
      i += seq;
      continue;
    }

    // Одиночный байт выше 0x7F: windows-1251, затем cp866
    if (b == 0xA8) {
      out[o++] = CYRILLIC_BASE + 32; // Ё (1251)
    } else if (b == 0xB8) {
      out[o++] = CYRILLIC_BASE + 65; // ё (1251)
    } else if (b >= 0xC0 && b <= 0xDF) {
      out[o++] = CYRILLIC_BASE + glyphIndex(0x0410 + (b - 0xC0)); // А-Я (1251)
    } else if (b >= 0xE0 && b <= 0xFF) {
      out[o++] = CYRILLIC_BASE + glyphIndex(0x0430 + (b - 0xE0)); // а-я (1251)
    } else if (b >= 0x80 && b <= 0x9F) {
      out[o++] = CYRILLIC_BASE + glyphIndex(0x0410 + (b - 0x80)); // А-Я (cp866)
    } else {
      out[o++] = b;
    }
    i++;
  }

  out[o] = 0;
  return o;
}
